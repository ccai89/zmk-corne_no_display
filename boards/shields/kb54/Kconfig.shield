## boards/shields/kb54/Kconfig.shield
```kconfig
# Copyright (c) 2020 Ryan Cross
# SPDX-License-Identifier: MIT

config SHIELD_KB54_LEFT
    def_bool $(shields_list_contains,kb54_left)

config SHIELD_KB54_RIGHT
    def_bool $(shields_list_contains,kb54_right)

config SHIELD_KB54_LEFT_PERIPHERAL
    def_bool $(shields_list_contains,kb54_left_peripheral)

config SHIELD_KB54_DONGLE_XIAO
    def_bool $(shields_list_contains,kb54_dongle_xiao)

config SHIELD_KB54_DONGLE_PRO_MICRO
    def_bool $(shields_list_contains,kb54_dongle_pro_micro)
```

## config/Kconfig.shield
```kconfig
# Copyright (c) 2020 Ryan Cross
# SPDX-License-Identifier: MIT

config SHIELD_CCAIKB_LEFT
    def_bool $(shields_list_contains,ccaikb_left)

config SHIELD_CCAIKB_RIGHT
    def_bool $(shields_list_contains,ccaikb_right)

config SHIELD_CCAIKB_LEFT_PERIPHERAL
    def_bool $(shields_list_contains,ccaikb_left_peripheral)

config SHIELD_CCAIKB_DONGLE_XIAO
    def_bool $(shields_list_contains,ccaikb_dongle_xiao)

config SHIELD_CCAIKB_DONGLE_PRO_MICRO
    def_bool $(shields_list_contains,ccaikb_dongle_pro_micro)
```

## config/west.yml
```yaml
manifest:
  remotes:
    - name: zmkfirmware
      url-base: https://github.com/zmkfirmware
    # support nice_oled and nice_epaper
    - name: mctechnology17
      url-base: https://github.com/mctechnology17
    - name: kb54
      url-base: http://github.com/ccai89
  projects:
    - name: zmk
      remote: zmkfirmware
      revision: main
      import: app/west.yml
  self:
    path: config
```
